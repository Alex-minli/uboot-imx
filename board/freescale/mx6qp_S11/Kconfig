## board/freescale/mx6qp_S11/Kconfig
```kconfig
if TARGET_MX6QP_S11

config SYS_BOARD
	default "mx6qp_S11"

config SYS_VENDOR
	default "freescale"

config SYS_SOC
	default "mx6"

config SYS_CONFIG_NAME
	default "mx6qp_S11"

endif
```

## configs/mx6qp_S11_android_defconfig
```kconfig
CONFIG_SYS_EXTRA_OPTIONS="IMX_CONFIG=board/freescale/mx6qp_S11/mx6qp_4x_NT5CC256M16DP.cfg,MX6QP,SYS_USE_SPINOR,ANDROID_SUPPORT"
CONFIG_ARM=y
CONFIG_TARGET_MX6QP_S11=y
CONFIG_SYS_MALLOC_F=y
CONFIG_SYS_MALLOC_F_LEN=0x400
CONFIG_DM=y
CONFIG_DM_THERMAL=y
```
